## drivers/hellopanic/Kconfig
```kconfig
config HELLOPANICMODULE
tristate "hello world panic module"
help
HelloPanic is a hello world world module.
```

## drivers/helloworld/Kconfig
```kconfig
config HELLOMODULE
tristate "hello world module"
help
HelloModule is a hello world module.
```
